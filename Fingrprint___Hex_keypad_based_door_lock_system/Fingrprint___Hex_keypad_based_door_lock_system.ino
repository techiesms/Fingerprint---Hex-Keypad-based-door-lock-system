/*
 * 
 * This is the code for the Project
 * IoT Security Project using Fingerprint sensor & Hex Keypad.
 * 
 * 
 * This code was written by Sachin Soni and Joy Jacob for 
 * project made for techiesms YouTube channel.You can 
 * watch the full tutorial video for the project on the
 * channel.
 * 
 * Anyone using this code for commercial purpose or replicating this
 * project on thier social medias should give credits to techiesms.
 * 
 * 
 * Channel Link :- http://www.youtube.com/techiesms
 * 
 * 
 *         techiesms
 * explore | learn | share
 * 
 */





#include "enrol.h"
#include "fingerprint.h"

// Icon of Fingerprint
#define LOGO_HEIGHT   64
#define LOGO_WIDTH    128
static const unsigned char PROGMEM logo_bmp[] =
{
  0x00, 0x00, 0x00, 0x00, 0x00, 0x00, 0x00, 0x00, 0x00, 0x00, 0x00, 0x00, 0x00, 0x00, 0x00, 0x00,
  0x00, 0x00, 0x00, 0x00, 0x00, 0x00, 0x00, 0x00, 0x00, 0x00, 0x00, 0x00, 0x00, 0x00, 0x00, 0x00,
  0x00, 0x00, 0x00, 0x00, 0x00, 0x00, 0x03, 0xff, 0xc0, 0x00, 0x00, 0x00, 0x00, 0x00, 0x00, 0x00,
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  0x00, 0x00, 0x00, 0x00, 0x00, 0x00, 0x00, 0x00, 0x00, 0x00, 0x00, 0x00, 0x00, 0x00, 0x00, 0x00
};



void setup()
{
  // put your setup code here, to run once:

  pinMode(Relay, OUTPUT);
  digitalWrite(buzzer, LOW);

  // SSD1306_SWITCHCAPVCC = generate display voltage from 3.3V internally
  if (!display.begin(SSD1306_SWITCHCAPVCC, 0x3C)) { // Address 0x3D for 128x64
    Serial.println(F("SSD1306 allocation failed"));
    for (;;); // Don't proceed, loop forever
  }

  initWifi();

  digitalWrite(buzzer, LOW);

}



void loop() {
  // put your main code here, to run repeatedly:

  char customKey = customKeypad.getKey();

  if (customKey)
  {
    Serial.println(customKey);

    // Maze Lock Mode
    if (customKey == 'A')
    {
      Serial.println("A");
      Serial.println("Maze Lock Mode");
      display.clearDisplay();
      display.setTextSize(2);             // Normal 1:1 pixel scale
      display.setTextColor(SSD1306_WHITE);        // Draw white text
      display.setCursor(10, 0);            // Start at top-left corner
      display.println(("Maze Lock"));
      display.setCursor(35, 30);
      display.println(("Mode"));
      display.display();
      beep(200);
      beep(200);
      delay(1000);

      Serial.println("Enter the \nFour Digit \nCode");

      fingerprint_flag = 0;
    }
    
    // Enrollment Mode
    if (customKey == 'C')
    {
      beep(200);
      if (Keypad_Input() == Secret_Code)
      {
        Serial.println("D");
        Serial.println("Enrollment mode");
        display.clearDisplay();
        display.setTextSize(2);             // Normal 1:1 pixel scale
        display.setTextColor(SSD1306_WHITE);        // Draw white text
        display.setCursor(0, 0);            // Start at top-left corner
        display.println(("Enrollment"));
        display.setCursor(35, 30);
        display.println(("Mode"));
        display.display();
        beep(200);
        beep(200);
        delay(1000);
        Serial.println("Enter ID");
        display.clearDisplay();
        display.setTextSize(2);             // Normal 1:1 pixel scale
        display.setTextColor(SSD1306_WHITE);        // Draw white text
        display.setCursor(35, 20);            // Start at top-left corner
        display.println(("ID XXX"));
        display.display();
        ID_e = "";
        i = 0;
        fingerprint_flag = 2;
        setup_e();
        loop_e();
        fingerprint_flag = 1;
      }
      else
      {
        Serial.println("Wrong Code");
        display.clearDisplay();
        display.setTextSize(2);             // Normal 1:1 pixel scale
        display.setTextColor(SSD1306_WHITE);        // Draw white text
        display.setCursor(0, 20);            // Start at top-left corner
        display.println(("Wrong Code"));
        display.display();
        beep(200);
        beep(200);
        delay(1000);
      }
    }
  }


  if (fingerprint_flag == 1)
  {
    finger.fingerID = 0;
    delay(50);
    setup_f();
    loop_f();
    display.clearDisplay();
    display.drawBitmap(0, 0, logo_bmp, LOGO_WIDTH, LOGO_HEIGHT, 1);
    display.display();
    customKey = customKeypad.getKey();
    if (customKey == 'C' || customKey == 'A')
    break;
    delay(1000);
  }


  if (fingerprint_flag == 0)
  {
    if (Keypad_Input() == Secret_Code)
    {
      Serial.println("Correct Code");
      display.clearDisplay();
      display.setTextSize(2);             // Normal 1:1 pixel scale
      display.setTextColor(SSD1306_WHITE);        // Draw white text
      display.setCursor(0, 20);            // Start at top-left corner
      display.println(("Correct Code"));
      beep(1000);
      display.display();
      Door_control();
      ID = 200;
      makeIFTTTRequest();

      delay(1000);

      fingerprint_flag = 1;
    }
    else
    {
      Serial.println("Wrong Code");
      display.clearDisplay();
      display.setTextSize(2);             // Normal 1:1 pixel scale
      display.setTextColor(SSD1306_WHITE);        // Draw white text
      display.setCursor(0, 20);            // Start at top-left corner
      display.println(("Wrong Code"));
      display.display();
      beep(200);
      beep(200);
      delay(1000);
      display.clearDisplay();
      display.setTextSize(2);             // Normal 1:1 pixel scale
      display.setTextColor(SSD1306_WHITE);        // Draw white text
      display.setCursor(35, 20);            // Start at top-left corner
      display.println(("Code"));
      display.display();
    }
    ID_e = "";
  }
}


// Establish a Wi-Fi connection with your router
void initWifi()
{
  Serial.print("Connecting to: ");
  Serial.print(ssid);
  display.clearDisplay();

  display.setTextSize(2);             // Normal 1:1 pixel scale
  display.setTextColor(SSD1306_WHITE);        // Draw white text
  display.setCursor(0, 0);            // Start at top-left corner
  display.println(("Connecting"));
  display.setCursor(0, 50);
  display.println((ssid));
  display.display();
  delay(2000);
  WiFi.begin(ssid, password);

  int timeout = 10 * 4; // 10 seconds
  while (WiFi.status() != WL_CONNECTED  && (timeout-- > 0)) {
    delay(250);
    Serial.print(".");
  }
  Serial.println("");

  if (WiFi.status() != WL_CONNECTED) {
    Serial.println("Failed to connect, going back to sleep");
    display.clearDisplay();
    display.setTextSize(2);             // Normal 1:1 pixel scale
    display.setTextColor(SSD1306_WHITE);        // Draw white text
    display.setCursor(0, 30);            // Start at top-left corner
    display.println(("Not \nConnected"));
    display.display();
  }
  else
  {
    Serial.print("WiFi connected in: ");
    Serial.print(millis());
    Serial.print(", IP address: ");
    Serial.println(WiFi.localIP());
    display.clearDisplay();
    display.setTextSize(2);             // Normal 1:1 pixel scale
    display.setTextColor(SSD1306_WHITE);        // Draw white text
    display.setCursor(0, 30);            // Start at top-left corner
    display.println(("Connected"));
    display.display();
  }
  delay(2000);
}
